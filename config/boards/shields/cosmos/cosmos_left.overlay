#include "cosmos.dtsi"
#include "pmw3610.dtsi"

&kscan0 {
    col-gpios = <&gpio0 9 (GPIO_ACTIVE_HIGH | GPIO_PULL_DOWN)>
                , <&gpio0 10 (GPIO_ACTIVE_HIGH | GPIO_PULL_DOWN)>
                , <&gpio1 11 (GPIO_ACTIVE_HIGH | GPIO_PULL_DOWN)>
                , <&gpio1 13 (GPIO_ACTIVE_HIGH | GPIO_PULL_DOWN)>
                , <&gpio1 15 (GPIO_ACTIVE_HIGH | GPIO_PULL_DOWN)>
                , <&gpio0 2 (GPIO_ACTIVE_HIGH | GPIO_PULL_DOWN)>;
};

&spi0 {
    status = "disabled";
};

&trackball {
    status = "disabled";
};

&default_transform {
    col-offset = <6>;
};

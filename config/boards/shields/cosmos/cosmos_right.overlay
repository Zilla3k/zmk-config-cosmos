#include "cosmos.dtsi"
#include "pmw3610.dtsi"
#include <zephyr/dt-bindings/input/input-event-codes.h>
#include <dt-bindings/zmk/input_transform.h>

&kscan0 {
    col-gpios = <&gpio0 9 (GPIO_ACTIVE_HIGH | GPIO_PULL_DOWN)>
                , <&gpio0 10 (GPIO_ACTIVE_HIGH | GPIO_PULL_DOWN)>
                , <&gpio1 11 (GPIO_ACTIVE_HIGH | GPIO_PULL_DOWN)>
                , <&gpio1 13 (GPIO_ACTIVE_HIGH | GPIO_PULL_DOWN)>
                , <&gpio1 15 (GPIO_ACTIVE_HIGH | GPIO_PULL_DOWN)>
                , <&gpio0 2 (GPIO_ACTIVE_HIGH | GPIO_PULL_DOWN)>;
};

&default_transform {
    col-offset = <6>;
};

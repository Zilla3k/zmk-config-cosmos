## config/boards/shields/cosmos/Kconfig.defconfig
```kconfig
if SHIELD_cosmos_RIGHT

config ZMK_KEYBOARD_NAME
	default "Cosmos"

config ZMK_SPLIT_BLE_ROLE_CENTRAL
	default y

endif

if SHIELD_cosmos_LEFT || SHIELD_cosmos_RIGHT

config ZMK_SPLIT
	default y
	
endif
```

## config/boards/shields/cosmos/Kconfig.shield
```kconfig
config SHIELD_cosmos_LEFT
	def_bool $(shields_list_contains,cosmos_left)

config SHIELD_cosmos_RIGHT
	def_bool $(shields_list_contains,cosmos_right)
```
